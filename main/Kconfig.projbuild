## main/Kconfig.projbuild
```kconfig
menu "Example Configuration"

    choice BLINK_LED
        prompt "Blink LED type"
        default BLINK_LED_GPIO if IDF_TARGET_ESP32
        default BLINK_LED_RMT
        help
            Defines the default peripheral for blink example

        config BLINK_LED_GPIO
            bool "GPIO"
        config BLINK_LED_RMT
            bool "RMT - Addressable LED"
    endchoice

    config BLINK_LED_RMT_CHANNEL
        depends on BLINK_LED_RMT
        int "RMT Channel"
        range 0 7
        default 0
        help
            Set the RMT peripheral channel.
            ESP32 RMT channel from 0 to 7
            ESP32-S2 RMT channel from 0 to 3
            ESP32-S3 RMT channel from 0 to 3
            ESP32-C3 RMT channel from 0 to 1

    config BLINK_GPIO
        int "Blink GPIO number"
        range 0 48
        default 8 if IDF_TARGET_ESP32C3 || IDF_TARGET_ESP32H2
        default 18 if IDF_TARGET_ESP32S2
        default 48 if IDF_TARGET_ESP32S3
        default 5
        help
            GPIO number (IOxx) to blink on and off or the RMT signal for the addressable LED.
            Some GPIOs are used for other purposes (flash connections, etc.) and cannot be used to blink.

    config BLINK_PERIOD
        int "Blink period in ms"
        range 10 3600000
        default 1000
        help
            Define the blinking period in milliseconds.

        config EXAMPLE_BASIC_AUTH
            bool "Basic Authentication"
            default n
            help
                Basic Authentication is a method for an HTTP user agent (e.g. a web browser)
                to provide a user name and password when making a request. It is the simplest
                technique for enforcing access controls to web resources. because it doesn't
                require cookies, session identifiers, or login pages; rather, it uses standard
                fields in the HTTP header.
                Note that, Basic Authentication is not encrypted channel and also easy to retrieve
                credentials as they are sent in plain text format.
    
        config EXAMPLE_BASIC_AUTH_USERNAME
            string "Basic Authenticate User Name"
            depends on EXAMPLE_BASIC_AUTH
            default "ESP32"
            help
                The client's user name which used for basic authenticate.
    
        config EXAMPLE_BASIC_AUTH_PASSWORD
            string "Basic Authenticate Password"
            depends on EXAMPLE_BASIC_AUTH
            default "ESP32Webserver"
            help
                The client's password which used for basic authenticate.

endmenu
```
